## main/Kconfig.projbuild
```kconfig
menu "T-Dongle-S3 adapter"
 config ADAPTER_DISPLAY
  bool "ST7735 status UI"
  default y
 config ADAPTER_LED
  bool "APA102 status LED (fixed board pins)"
  default y
endmenu
```
